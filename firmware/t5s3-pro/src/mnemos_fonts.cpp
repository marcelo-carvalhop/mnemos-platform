#include "mnemos_fonts.h"

#include <algorithm>
#include <cstring>

namespace {
struct MnemosFontGlyph {
    uint32_t codepoint;
    uint32_t bitmapOffset;
    uint8_t width;
    uint8_t height;
    int8_t xOffset;
    int8_t yOffset;
    uint8_t advance;
};

constexpr uint16_t GLYPH_COUNT_14 = 440;
constexpr uint32_t BITMAP_BYTES_14 = 8209;
static const MnemosFontGlyph GLYPHS_14[GLYPH_COUNT_14] PROGMEM = {
    {32U, 0U, 0, 0, 0, 0, 3},
    {33U, 0U, 5, 11, 0, -11, 5},
    {34U, 7U, 8, 11, 0, -11, 8},
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    {38382U, 8182U, 14, 15, 0, -12, 14},
};
static const uint8_t BITMAP_14[BITMAP_BYTES_14] PROGMEM = {
    0x73, 0x9C, 0xE3, 0x18, 0xC4, 0x23, 0x9C, 0x76, 0x66, 0x66, 0x66, 0x66, 0x00, 0x00, 0x00, 0x00, 0x00, 0x00, 0x00, 0x36, 0x36, 0x7E, 0x7F, 0x36,
    0x7E, 0xFF, 0x6C, 0x6C, 0x6C, 0x18, 0x18, 0x3E, 0x7E, 0x60, 0x70, 0x3C, 0x0E, 0x06, 0x66, 0x7E, 0x7C, 0x18, 0x00, 0x78, 0xC1, 0xE3, 0x0C, 0xD8,
    0x33, 0x60, 0xCF, 0x71, 0xEF, 0xE7, 0xED, 0x81, 0xB6, 0x0C, 0xD8, 0x33, 0xE1, 0x87, 0x00, 0x1C, 0x07, 0xC0, 0xD8, 0x1F, 0x03, 0xC0, 0xF1, 0x9F,
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    0x00,
};

constexpr uint16_t GLYPH_COUNT_18 = 440;
constexpr uint32_t BITMAP_BYTES_18 = 13122;
static const MnemosFontGlyph GLYPHS_18[GLYPH_COUNT_18] PROGMEM = {
    {32U, 0U, 0, 0, 0, 0, 4},
    {33U, 0U, 7, 14, 0, -14, 7},
    {34U, 13U, 10, 14, 0, -14, 10},
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    {38382U, 13079U, 18, 19, 0, -16, 18},
};
static const uint8_t BITMAP_18[BITMAP_BYTES_18] PROGMEM = {
    0x38, 0x70, 0xE1, 0xC3, 0x87, 0x0E, 0x1C, 0x30, 0x00, 0x41, 0xC3, 0x87, 0x00, 0x73, 0x9C, 0xE7, 0x38, 0xCE, 0x33, 0x8C, 0xE2, 0x10, 0x00, 0x00,
    0x00, 0x00, 0x00, 0x00, 0x00, 0x00, 0x00, 0x00, 0x03, 0x30, 0x66, 0x0C, 0xC7, 0xFC, 0xFF, 0x8C, 0xC1, 0x98, 0x7F, 0xDF, 0xF8, 0xCC, 0x19, 0x83,
    0x30, 0x6C, 0x00, 0x00, 0x01, 0x80, 0x30, 0x0F, 0x83, 0xF8, 0xF3, 0x1C, 0x03, 0xC0, 0x3E, 0x03, 0xE0, 0x1E, 0x01, 0xC0, 0x3C, 0xE7, 0x1F, 0xE1,
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    0xDF, 0xEE, 0x77, 0xFB, 0x9D, 0xC0, 0xE7, 0x20, 0x39, 0xC0, 0x0E, 0x70, 0x0F, 0x9C, 0x03, 0xC0, 0x00, 0x00,
};

constexpr uint16_t GLYPH_COUNT_22 = 440;
constexpr uint32_t BITMAP_BYTES_22 = 19706;
static const MnemosFontGlyph GLYPHS_22[GLYPH_COUNT_22] PROGMEM = {
    {32U, 0U, 0, 0, 0, 0, 5},
    {33U, 0U, 8, 18, 0, -18, 8},
    {34U, 18U, 13, 17, 0, -17, 13},
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    {38382U, 19645U, 22, 22, 0, -19, 22},
};
static const uint8_t BITMAP_22[BITMAP_BYTES_22] PROGMEM = {
    0x00, 0x3C, 0x3C, 0x3C, 0x3C, 0x3C, 0x3C, 0x3C, 0x1C, 0x1C, 0x18, 0x18, 0x00, 0x00, 0x3C, 0x3C, 0x3C, 0x1C, 0x39, 0xE1, 0xCF, 0x0E, 0x78, 0x73,
    0xC3, 0x9E, 0x1C, 0x70, 0xE3, 0x07, 0x18, 0x00, 0x00, 0x00, 0x00, 0x00, 0x00, 0x00, 0x00, 0x00, 0x00, 0x00, 0x00, 0x00, 0x00, 0x00, 0x00, 0x00,
    0x63, 0x03, 0x38, 0x19, 0xC1, 0xCE, 0x3F, 0xF9, 0xFF, 0xC3, 0x98, 0x18, 0xC0, 0xCE, 0x1F, 0xFC, 0xFF, 0xE3, 0x9C, 0x1C, 0xC0, 0xE6, 0x06, 0x30,
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    0x07, 0x80,
};

uint32_t nextCodepoint(const char*& p) {
    const uint8_t c0 = static_cast<uint8_t>(*p++);

    if (c0 < 0x80) {
        return c0;
    }

    if ((c0 & 0xE0) == 0xC0) {
        const uint8_t c1 = static_cast<uint8_t>(*p++);
        return ((c0 & 0x1F) << 6) | (c1 & 0x3F);
    }

    if ((c0 & 0xF0) == 0xE0) {
        const uint8_t c1 = static_cast<uint8_t>(*p++);
        const uint8_t c2 = static_cast<uint8_t>(*p++);
        return ((c0 & 0x0F) << 12) |
               ((c1 & 0x3F) << 6) |
               (c2 & 0x3F);
    }

    if ((c0 & 0xF8) == 0xF0) {
        const uint8_t c1 = static_cast<uint8_t>(*p++);
        const uint8_t c2 = static_cast<uint8_t>(*p++);
        const uint8_t c3 = static_cast<uint8_t>(*p++);
        return ((c0 & 0x07) << 18) |
               ((c1 & 0x3F) << 12) |
               ((c2 & 0x3F) << 6) |
               (c3 & 0x3F);
    }

    return static_cast<uint32_t>('?');
}

struct FontView {
    const MnemosFontGlyph* glyphs;
    const uint8_t* bitmap;
    uint16_t glyphCount;
};

FontView fontView(MnemosFontRole role) {
    switch (role) {
        case MnemosFontRole::Meta14:
            return {GLYPHS_14, BITMAP_14, GLYPH_COUNT_14};

        case MnemosFontRole::Title22:
            return {GLYPHS_22, BITMAP_22, GLYPH_COUNT_22};

        case MnemosFontRole::Body18:
        default:
            return {GLYPHS_18, BITMAP_18, GLYPH_COUNT_18};
    }
}

bool loadGlyph(const FontView& view,
               uint32_t codepoint,
               MnemosFontGlyph& out) {
    int32_t lo = 0;
    int32_t hi = static_cast<int32_t>(view.glyphCount) - 1;

    while (lo <= hi) {
        const int32_t mid = (lo + hi) / 2;

        MnemosFontGlyph probe;
        memcpy_P(&probe, &view.glyphs[mid], sizeof(probe));

        if (probe.codepoint == codepoint) {
            out = probe;
            return true;
        }

        if (probe.codepoint < codepoint) {
            lo = mid + 1;
        } else {
            hi = mid - 1;
        }
    }

    return false;
}

bool getGlyph(const FontView& view,
              uint32_t codepoint,
              MnemosFontGlyph& out) {
    if (loadGlyph(view, codepoint, out)) {
        return true;
    }

    return loadGlyph(
        view,
        static_cast<uint32_t>('?'),
        out);
}

}  // namespace

int32_t mnemosFontTextWidth(
    const String& text,
    MnemosFontRole role) {

    const FontView view = fontView(role);
    const char* p = text.c_str();
    int32_t width = 0;

    while (*p) {
        MnemosFontGlyph glyph;

        if (!getGlyph(
                view,
                nextCodepoint(p),
                glyph)) {
            continue;
        }

        width += glyph.advance;
    }

    return width;
}

bool mnemosFontVisualBounds(
    const String& text,
    MnemosFontRole role,
    int32_t& left,
    int32_t& top,
    int32_t& right,
    int32_t& bottom) {

    const FontView view =
        fontView(role);

    const char* p =
        text.c_str();

    int32_t cursor = 0;
    bool hasInk = false;
    int32_t minX = 0;
    int32_t minY = 0;
    int32_t maxX = 0;
    int32_t maxY = 0;

    while (*p) {
        MnemosFontGlyph glyph;

        if (!getGlyph(
                view,
                nextCodepoint(p),
                glyph)) {
            continue;
        }

        if (
            glyph.width > 0 &&
            glyph.height > 0
        ) {
            const int32_t glyphLeft =
                cursor +
                glyph.xOffset;

            const int32_t glyphTop =
                glyph.yOffset;

            const int32_t glyphRight =
                glyphLeft +
                glyph.width;

            const int32_t glyphBottom =
                glyphTop +
                glyph.height;

            if (!hasInk) {
                minX = glyphLeft;
                minY = glyphTop;
                maxX = glyphRight;
                maxY = glyphBottom;
                hasInk = true;
            } else {
                minX =
                    std::min(
                        minX,
                        glyphLeft);

                minY =
                    std::min(
                        minY,
                        glyphTop);

                maxX =
                    std::max(
                        maxX,
                        glyphRight);

                maxY =
                    std::max(
                        maxY,
                        glyphBottom);
            }
        }

        cursor +=
            glyph.advance;
    }

    if (!hasInk) {
        left = 0;
        top = 0;
        right = cursor;
        bottom = 0;
        return false;
    }

    left = minX;
    top = minY;
    right = maxX;
    bottom = maxY;
    return true;
}

bool mnemosFontTextBounds(
    const String& text,
    MnemosFontRole role,
    int32_t& left,
    int32_t& right) {

    int32_t top = 0;
    int32_t bottom = 0;

    return
        mnemosFontVisualBounds(
            text,
            role,
            left,
            top,
            right,
            bottom);
}


void mnemosFontDrawText(
    const String& text,
    int32_t x,
    int32_t baselineY,
    uint8_t* framebuffer,
    int32_t canvasWidth,
    int32_t canvasHeight,
    MnemosFontRole role,
    uint8_t color,
    uint8_t scale) {

    if (!framebuffer ||
        canvasWidth <= 0 ||
        canvasHeight <= 0 ||
        scale == 0) {
        return;
    }

    const FontView view = fontView(role);
    const char* p = text.c_str();
    int32_t cursor = x;

    auto putPixel =
        [&](int32_t px, int32_t py) {
            if (px < 0 ||
                py < 0 ||
                px >= canvasWidth ||
                py >= canvasHeight) {
                return;
            }

            framebuffer[
                static_cast<size_t>(py) *
                static_cast<size_t>(canvasWidth) +
                static_cast<size_t>(px)
            ] = color;
        };

    while (*p) {
        MnemosFontGlyph glyph;

        if (!getGlyph(
                view,
                nextCodepoint(p),
                glyph)) {
            continue;
        }

        const uint32_t pixelCount =
            static_cast<uint32_t>(glyph.width) *
            static_cast<uint32_t>(glyph.height);

        for (uint32_t i = 0; i < pixelCount; ++i) {
            const uint8_t packed =
                pgm_read_byte(
                    &view.bitmap[
                        glyph.bitmapOffset +
                        i / 8U]);

            if ((packed &
                 (0x80U >> (i % 8U))) == 0) {
                continue;
            }

            const int32_t glyphX =
                glyph.xOffset +
                static_cast<int32_t>(
                    i % glyph.width);

            const int32_t glyphY =
                glyph.yOffset +
                static_cast<int32_t>(
                    i / glyph.width);

            for (uint8_t yy = 0; yy < scale; ++yy) {
                for (uint8_t xx = 0; xx < scale; ++xx) {
                    putPixel(
                        cursor +
                            glyphX * scale +
                            xx,
                        baselineY +
                            glyphY * scale +
                            yy);
                }
            }
        }

        cursor +=
            static_cast<int32_t>(
                glyph.advance) *
            scale;
    }
}
